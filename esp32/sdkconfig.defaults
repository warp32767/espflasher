## esp32/sdkconfig.defaults
```kconfig
CONFIG_ESPTOOLPY_FLASHSIZE_4MB=y
CONFIG_ESPTOOLPY_FLASHMODE_DIO=y
CONFIG_ESPTOOLPY_FLASHFREQ_40M=y

CONFIG_FREERTOS_HZ=1000

CONFIG_LWIP_TCP_KEEPALIVE=y
CONFIG_LWIP_SO_REUSE=y
```
